## code/open-task-light/main/Kconfig.projbuild
```kconfig
menu "Open Task Light"

menu "Serial logging"

config OTL_SERIAL_OUTPUT
    bool "Enable serial log output"
    default y
    help
        Enables application log output via ESP_LOGx/printf. When disabled, the
        application also sets the global ESP log level to NONE at runtime.
        (Boot/ROM logs may still appear; use the ESP-IDF log output settings
        to disable those.)

menu "Serial logging options"
    depends on OTL_SERIAL_OUTPUT

config OTL_LOG_STATUS
    bool "Enable periodic status logs (every 10s)"
    default y
    help
        Enables the periodic status line printed by the sensor task (light
        state, brightness/temp, ALS lux, NTC/chip temperature).

config OTL_SENSOR_DEBUG
    bool "Enable sensor debug logs (raw ADC)"
    default n
    help
        Logs raw ADC values and computed voltages for the ALS/NTC sensors.
        Useful when debugging wiring/pin mapping (e.g., always reading 0 or 4095).

config OTL_LOG_TOUCH_EVENTS
    bool "Enable touch UI event logs"
    default y
    help
        Logs touch-driven UI events (on/off, brightness changes, temp changes).

config OTL_LOG_TOUCH_CAL
    bool "Enable touch calibration logs"
    default y
    help
        Logs touch calibration output (baseline/threshold) at startup and during
        periodic recalibration.

config OTL_LOG_TOUCH_RAW
    bool "Enable raw touch pad value logs"
    default n
    help
        Logs raw capacitive touch values and thresholds for each pad at a fixed
        interval. Useful when tuning thresholds or debugging grounding/noise.

config OTL_TOUCH_RAW_LOG_INTERVAL_MS
    int "Raw touch log interval (ms)"
    depends on OTL_LOG_TOUCH_RAW
    range 10 5000
    default 200

config OTL_LOG_PWM_DUTY
    bool "Enable PWM duty logs during transitions"
    default n
    help
        Logs warm/cool PWM duty (and targets) while outputs are changing.
        Useful for debugging dimming ramps, fades, and hold behavior.

config OTL_PWM_LOG_INTERVAL_MS
    int "PWM duty log interval (ms)"
    depends on OTL_LOG_PWM_DUTY
    range 5 5000
    default 50

endmenu

endmenu

menu "Connectivity"

config OTL_WIFI_ENABLE
    bool "Enable WiFi"
    default n
    help
        Enables the shared WiFi station subsystem used by circadian lighting,
        Home Assistant MQTT integration, and Apple Home/HomeKit support.

menu "WiFi settings"
    depends on OTL_WIFI_ENABLE

config OTL_WIFI_SSID
    string "WiFi SSID"
    default ""

config OTL_WIFI_PASSWORD
    string "WiFi Password"
    default ""

config OTL_WIFI_HOSTNAME
    string "WiFi hostname"
    default "open-task-light"
    help
        Optional hostname advertised on the local network for this device.

endmenu

config OTL_HA_MQTT_ENABLE
    bool "Enable Home Assistant via MQTT"
    depends on OTL_WIFI_ENABLE
    default n
    help
        Publishes Home Assistant MQTT discovery, state, and command topics for
        native integration without ESPHome.

config OTL_HA_MQTT_DEP_ENABLE
    int
    default 1 if OTL_HA_MQTT_ENABLE
    default 0

menu "Home Assistant MQTT settings"
    depends on OTL_HA_MQTT_ENABLE

config OTL_MQTT_BROKER_URI
    string "MQTT broker URI"
    default "mqtt://homeassistant.local"

config OTL_MQTT_USERNAME
    string "MQTT username"
    default ""

config OTL_MQTT_PASSWORD
    string "MQTT password"
    default ""

config OTL_MQTT_DISCOVERY_PREFIX
    string "Home Assistant discovery prefix"
    default "homeassistant"

config OTL_MQTT_TOPIC_BASE
    string "MQTT topic base"
    default "open-task-light"

config OTL_MQTT_DEVICE_NAME
    string "MQTT device name"
    default "Open Task Light"

endmenu

config OTL_HOMEKIT_ENABLE
    bool "Enable Apple Home via HomeKit"
    depends on OTL_WIFI_ENABLE
    default n
    help
        Exposes the light as a native Apple Home accessory using Espressif's
        HomeKit SDK.

menu "HomeKit settings"
    depends on OTL_HOMEKIT_ENABLE

config OTL_HOMEKIT_ACCESSORY_NAME
    string "Accessory name"
    default "Open Task Light"

config OTL_HOMEKIT_SETUP_CODE
    string "Setup code"
    default "111-22-333"
    help
        Apple Home pairing code in XXX-XX-XXX format.

config OTL_HOMEKIT_SETUP_ID
    string "Setup ID"
    default "OTL1"
    help
        Four-character setup ID used when generating the pairing payload.

endmenu

endmenu

menu "Presence sensor"

config OTL_PRESENCE_SENSOR
    bool "Enable presence sensor (LD2410B)"
    default n
    help
        Enables the LD2410B presence sensor support (GPIO OUT + optional UART
        frame parsing) and occupancy-based fade in/out behavior.
        Disable if the sensor is not installed.

menu "Presence sensor options"
    depends on OTL_PRESENCE_SENSOR

config OTL_LOG_RADAR_STATUS
    bool "Enable presence sensor status logs"
    depends on OTL_SERIAL_OUTPUT
    default y
    help
        Logs periodic presence sensor status (OUT pins + moving/stationary
        distances). Disable to keep serial output quiet while still using
        presence-based dimming behavior.

config OTL_RADAR_DISABLE_BLUETOOTH_AT_BOOT
    bool "Disable LD2410B Bluetooth on first successful boot"
    default y
    help
        Sends the LD2410B UART command to disable the onboard Bluetooth radio.
        The radar stores this setting internally, and the firmware records a
        successful disable in NVS so the radar is not restarted again on every
        boot. Re-enable Bluetooth manually with the module's documented
        power-cycle recovery sequence if you need app access later.

menu "Radar detection"

config OTL_RADAR_MOVING_MAX_DISTANCE_CM
    int "Moving target max distance (cm)"
    range 50 1000
    default 300
    help
        Maximum distance for moving targets to count as presence.

config OTL_RADAR_STATIONARY_MAX_DISTANCE_CM
    int "Stationary target max distance (cm)"
    range 50 1000
    default 500
    help
        Maximum distance for stationary targets to count as presence.

config OTL_RADAR_PRESENCE_ON_DELAY_MS
    int "Presence on delay (ms)"
    range 0 60000
    default 3000
    help
        Presence must be continuous for at least this long before occupancy
        turns on.

config OTL_RADAR_ABSENCE_TIMEOUT_MS
    int "Absence timeout (ms)"
    range 1000 600000
    default 30000
    help
        Absence must be continuous for at least this long before occupancy
        turns off.

config OTL_RADAR_TASK_LOOP_MS
    int "Radar task loop interval (ms)"
    range 10 500
    default 50
    help
        Poll interval for radar UART/presence processing.

endmenu

endmenu

endmenu

menu "PWM"

config OTL_NONOVERLAP_PWM
    bool "Non-overlapping warm/cool PWM"
    default y
    help
        When enabled, warm and cool PWM outputs are time-multiplexed (phase
        shifted) so they are never ON at the same time within a PWM cycle.
        This can reduce peak current draw and audible/EMI artifacts.
        Note: this currently disables LEDC hardware fade for those channels.

endmenu

menu "Circadian lighting"

config OTL_CIRCADIAN_ENABLE
    bool "Enable circadian color temperature (WiFi + SNTP)"
    depends on OTL_WIFI_ENABLE
    default n
    help
        Connects to WiFi, syncs local time via SNTP, and continuously updates
        the warm/cool mix over a 24-hour cycle: cooler during the day and
        warmer as evening/night approaches.

menu "Circadian settings"
    depends on OTL_CIRCADIAN_ENABLE

config OTL_TIMEZONE
    string "Timezone (POSIX TZ string)"
    default "UTC0"
    help
        Newlib uses POSIX TZ strings (not IANA names like America/Los_Angeles).
        Example (US Pacific w/ DST): PST8PDT,M3.2.0/2,M11.1.0/2
        Example (US Eastern w/ DST): EST5EDT,M3.2.0/2,M11.1.0/2
        Example (UTC): UTC0

config OTL_SNTP_SERVER
    string "SNTP server"
    default "pool.ntp.org"

config OTL_CIRCADIAN_UPDATE_INTERVAL_SEC
    int "Update interval (seconds)"
    range 5 3600
    default 60
    help
        How often the firmware recalculates the target warm/cool mix based on
        local time. Smaller values are smoother but wake the CPU more often.

config OTL_CIRCADIAN_COOLEST_TIME
    string "Coolest time (HH:MM)"
    default "11:00"
    help
        Local time in 24-hour format. Examples: 09:00, 11:30, 23:45.

config OTL_CIRCADIAN_WARMEST_TIME
    string "Warmest time (HH:MM)"
    default "23:00"
    help
        Local time in 24-hour format. Examples: 19:30, 21:00, 00:15.

config OTL_CIRCADIAN_COOL_MIN_PCT
    int "Minimum cool ratio (%)"
    range 0 100
    default 0

config OTL_CIRCADIAN_COOL_MAX_PCT
    int "Maximum cool ratio (%)"
    range 0 100
    default 100

endmenu

endmenu

endmenu
```

## code/open-task-light/sdkconfig.defaults
```kconfig
# Open Task Light - Default Configuration
# Copy to sdkconfig or run `idf.py menuconfig` to customize.
# Connectivity features are disabled by default and can be enabled via menuconfig.

CONFIG_OTL_SERIAL_OUTPUT=y
CONFIG_OTL_LOG_STATUS=y
CONFIG_OTL_NONOVERLAP_PWM=y
CONFIG_OTL_PRESENCE_SENSOR=n
CONFIG_OTL_RADAR_PRESENCE_ON_DELAY_MS=1000
CONFIG_OTL_RADAR_ABSENCE_TIMEOUT_MS=120000
CONFIG_TOUCH_SUPPRESS_DEPRECATE_WARN=y
CONFIG_LWIP_MAX_SOCKETS=16
CONFIG_PARTITION_TABLE_CUSTOM=y
CONFIG_PARTITION_TABLE_CUSTOM_FILENAME="partitions.csv"
```
